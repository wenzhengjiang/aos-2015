## libs/liblog/Kconfig
```kconfig
#
# Copyright 2014, NICTA
#
# This software may be distributed and modified according to the terms of
# the BSD 2-Clause license. Note that NO WARRANTY is provided.
# See "LICENSE_BSD2.txt" for details.
#
# @TAG(NICTA_BSD)
#

config LIB_LOG
    bool "Build liblog"
    select LIB_SEL4 
    select HAVE_SEL4_LIBS
    default y
    help
        "Logging interface for seL4 sos"
```

## libs/libproc/Kconfig
```kconfig
#
# Copyright 2014, NICTA
#
# This software may be distributed and modified according to the terms of
# the BSD 2-Clause license. Note that NO WARRANTY is provided.
# See "LICENSE_BSD2.txt" for details.
#
# @TAG(NICTA_BSD)
#

config LIB_PROC
    bool "Build proc library"
    select HAVE_SEL4_LIBS
    select LIB_SEL4
    select LIB_SEL4_C
    select LIB_SEL4_SYNC
    select LIB_DEVICE
    select LIB_UT
    select LIB_LOG
    select LIB_UTILS
    default y
    help
        "SOS processes"
```

## libs/libut/Kconfig
```kconfig
#
# Copyright 2014, NICTA
#
# This software may be distributed and modified according to the terms of
# the BSD 2-Clause license. Note that NO WARRANTY is provided.
# See "LICENSE_BSD2.txt" for details.
#
# @TAG(NICTA_BSD)
#

config LIB_UT
    bool "Build libut"
    select LIB_SEL4 
    select LIB_SEL4_C
    select LIB_SEL4_SYNC
    select LIB_SYS
    select HAVE_SEL4_LIBS
    default y
    help
        "Untyped interface for seL4 sos"
```
